## components/lightgw_i2c_bus/Kconfig
```kconfig
menu "Light Gateway shared I2C bus"

config LIGHTGW_I2C_SDA_GPIO
    int "Shared I2C SDA GPIO"
    default 6
    range 0 30

config LIGHTGW_I2C_SCL_GPIO
    int "Shared I2C SCL GPIO"
    default 7
    range 0 30

config LIGHTGW_I2C_FREQUENCY_HZ
    int "Shared I2C clock frequency"
    default 100000
    range 10000 400000

endmenu
```

## main/Kconfig.projbuild
```kconfig
menu "esp32lightctl modular firmware"

choice LIGHTGW_FIRMWARE_VARIANT
    prompt "Firmware feature variant"
    default LIGHTGW_VARIANT_CORE

config LIGHTGW_VARIANT_CORE
    bool "CORE"

config LIGHTGW_VARIANT_CORE_SENSOR
    bool "CORE_SENSOR"

config LIGHTGW_VARIANT_CORE_CLOUD
    bool "CORE_CLOUD"

config LIGHTGW_VARIANT_FULL
    bool "FULL"

endchoice

config LIGHTGW_BH1750_EXTENSION
    bool
    default y if LIGHTGW_VARIANT_CORE_SENSOR || LIGHTGW_VARIANT_FULL
    default n

config LIGHTGW_SHT31_EXTENSION
    bool
    default y if LIGHTGW_VARIANT_CORE_SENSOR || LIGHTGW_VARIANT_FULL
    default n

config LIGHTGW_RAINMAKER_EXTENSION
    bool
    default y if LIGHTGW_VARIANT_CORE_CLOUD || LIGHTGW_VARIANT_FULL
    default n

endmenu
```

## sdkconfig.defaults
```kconfig
CONFIG_IDF_TARGET="esp32c6"
CONFIG_PARTITION_TABLE_CUSTOM=y
CONFIG_PARTITION_TABLE_CUSTOM_FILENAME="partitions.csv"
CONFIG_ESPTOOLPY_FLASHSIZE_8MB=y
CONFIG_ESP_COEX_SW_COEXIST_ENABLE=y
CONFIG_ESP_WIFI_SLP_DEFAULT_MIN_ACTIVE_TIME=50
CONFIG_ESP_WIFI_SLP_DEFAULT_MAX_ACTIVE_TIME=10
CONFIG_ESP_WIFI_SLP_DEFAULT_WAIT_BROADCAST_DATA_TIME=15
CONFIG_HTTPD_MAX_REQ_HDR_LEN=1024
CONFIG_HTTPD_MAX_URI_LEN=256
CONFIG_MBEDTLS_HKDF_C=y
CONFIG_LWIP_SNTP_MAX_SERVERS=3
CONFIG_LWIP_SNTP_UPDATE_DELAY=3600000
CONFIG_ESP_COREDUMP_ENABLE_TO_FLASH=y
CONFIG_ESP_COREDUMP_DATA_FORMAT_ELF=y
CONFIG_LOG_DEFAULT_LEVEL_INFO=y
CONFIG_ZB_ENABLED=y
CONFIG_ZB_ZCZR=y
CONFIG_ZB_RADIO_NATIVE=y
```
